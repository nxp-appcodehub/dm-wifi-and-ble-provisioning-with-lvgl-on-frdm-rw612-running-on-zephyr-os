## CMakeLists.txt
```
#
# Copyright 2026 NXP
#
# SPDX-License-Identifier: Apache-2.0
#

cmake_minimum_required(VERSION 3.20.0)

set(BOARD frdm_rw612)
set(SHIELD lcd_par_s035_spi)

find_package(Zephyr REQUIRED HINTS $ENV{ZEPHYR_BASE})
project(lvgl_wifi_ble_prov)

target_sources(app PRIVATE
    src/main.c
    src/ble_prov.c
    src/wifi_mgr.c
    src/ui.c
)
```

## prj.conf
```kconfig
#
# Copyright 2026 NXP
#
# SPDX-License-Identifier: Apache-2.0
#

# System
CONFIG_HEAP_MEM_POOL_SIZE=131072
CONFIG_MAIN_STACK_SIZE=8192
CONFIG_SYSTEM_WORKQUEUE_STACK_SIZE=4096

# Logging
CONFIG_LOG=y
CONFIG_LOG_DEFAULT_LEVEL=3
CONFIG_PRINTK=y
CONFIG_SHELL=y

# Display
CONFIG_DISPLAY=y
CONFIG_DISPLAY_LOG_LEVEL_ERR=y

# LVGL
CONFIG_LVGL=y
CONFIG_LV_Z_MEM_POOL_SIZE=131072
CONFIG_LV_Z_SHELL=y
CONFIG_LV_USE_LOG=y
CONFIG_LV_USE_LABEL=y
CONFIG_LV_USE_ARC=y
CONFIG_LV_USE_BAR=y
CONFIG_LV_USE_SPINNER=y
CONFIG_LV_USE_MSGBOX=y
CONFIG_LV_COLOR_DEPTH_16=y
CONFIG_LV_FONT_MONTSERRAT_14=y
CONFIG_LV_FONT_MONTSERRAT_16=y
CONFIG_LV_FONT_MONTSERRAT_20=y
CONFIG_LV_FONT_MONTSERRAT_24=y
CONFIG_LV_FONT_MONTSERRAT_28=y
CONFIG_LV_FONT_MONTSERRAT_32=y
CONFIG_LV_USE_THEME_DEFAULT=y
CONFIG_LV_THEME_DEFAULT_DARK=n
CONFIG_LV_Z_AUTO_INIT=y

CONFIG_LV_Z_VDB_SIZE=10
CONFIG_LV_Z_DOUBLE_VDB=y

# Input / Touch
CONFIG_INPUT=y
CONFIG_INPUT_GT911=y
CONFIG_INPUT_GT911_INTERRUPT=y
CONFIG_LV_Z_POINTER_INPUT=y
CONFIG_LV_USE_KEYBOARD=y
CONFIG_LV_USE_LIST=y
CONFIG_LV_USE_TEXTAREA=y

# BLE
CONFIG_BT=y
CONFIG_BT_PERIPHERAL=y
CONFIG_BT_DEVICE_NAME="NXP-WiFi-Prov"
CONFIG_BT_DEVICE_NAME_DYNAMIC=n
CONFIG_BT_GATT_DYNAMIC_DB=y
CONFIG_BT_SMP=y
CONFIG_BT_BONDABLE=n
CONFIG_BT_PRIVACY=y
CONFIG_BT_MAX_CONN=1
CONFIG_BT_MAX_PAIRED=1
CONFIG_BT_RX_STACK_SIZE=2048

# Networking
CONFIG_NETWORKING=y
CONFIG_NET_IPV4=y
CONFIG_NET_UDP=y
CONFIG_NET_TCP=y
CONFIG_NET_SOCKETS=y
CONFIG_NET_L2_ETHERNET=y
CONFIG_NET_L2_ETHERNET_MGMT=y
CONFIG_NET_PROMISCUOUS_MODE=y
CONFIG_NET_L2_WIFI_MGMT=y
CONFIG_NXP_WIFI_NET_MONITOR=y
CONFIG_NXP_WIFI_HOST_TXRX_MGMT_FRAME=y

# Wi-Fi
CONFIG_WIFI=y
CONFIG_WIFI_NXP=y
CONFIG_NXP_RW610=y
CONFIG_WIFI_NM=y
CONFIG_NET_DHCPV4=y
CONFIG_NXP_WIFI_AUTO_INIT=y
CONFIG_NXP_WIFI_SHELL=y
CONFIG_WIFI_MGMT_SCAN_CHAN_MAX_MANUAL=50
CONFIG_SHELL=y
CONFIG_KERNEL_SHELL=y
CONFIG_DEVICE_SHELL=y
CONFIG_SHELL_BACKEND_SERIAL=y
CONFIG_SHELL_CMD_BUFF_SIZE=512
CONFIG_WIFI_NM_WPA_SUPPLICANT_CRYPTO_ENTERPRISE=n
CONFIG_NET_L2_WIFI_SHELL=y

# NVS / Settings
CONFIG_FLASH=y
CONFIG_FLASH_MAP=y
CONFIG_NVS=y
CONFIG_NVS_LOOKUP_CACHE=y
CONFIG_SETTINGS=y
CONFIG_SETTINGS_NVS=y
CONFIG_MPU_ALLOW_FLASH_WRITE=y

# GPIO
CONFIG_GPIO=y

# Timers / Work queues
CONFIG_EVENTS=y
CONFIG_POLL=y

CONFIG_WIFI_NM_WPA_SUPPLICANT_WPA3=n
CONFIG_WIFI_NM_WPA_SUPPLICANT_CRYPTO_ENTERPRISE=n

CONFIG_MIPI_DBI=y
CONFIG_ST7796S=y
CONFIG_LV_Z_BUFFER_ALLOC_DYNAMIC=y
```

## boards/frdm_rw612.overlay
```dts
/*
 * SPDX-License-Identifier: Apache-2.0
 *
*/
&standby {
	status = "okay";
};
```

## src/main.c
```c
/*
* Copyright 2026 NXP
*
* SPDX-License-Identifier: Apache-2.0
*/

#include <zephyr/kernel.h>
#include <zephyr/logging/log.h>
#include <zephyr/version.h>
#include <zephyr/bluetooth/bluetooth.h>
#include <zephyr/net/net_if.h>
#include <zephyr/net/net_ip.h>

#include <string.h>
#include <stdio.h>

#include "ble_prov.h"
#include "wifi_mgr.h"
#include "ui.h"

LOG_MODULE_REGISTER(main, LOG_LEVEL_INF);

typedef enum {
	APP_EVT_BLE_CONNECTED,
	APP_EVT_BLE_DISCONNECTED,
	APP_EVT_CREDS_RECEIVED,
	APP_EVT_WIFI_CONNECTING,
	APP_EVT_WIFI_CONNECTED,
	APP_EVT_WIFI_FAILED,
	APP_EVT_WIFI_DISCONNECTED,
} app_evt_type_t;

typedef struct {
	app_evt_type_t type;
	char ssid[BLE_PROV_SSID_MAX_LEN + 1];
	char psk [BLE_PROV_PSK_MAX_LEN  + 1];
} app_evt_t;

K_MSGQ_DEFINE(s_app_evq, sizeof(app_evt_t), 8, 4);

typedef enum {
	APP_STATE_BOOT = 0,
	APP_STATE_ADVERTISING,
	APP_STATE_BLE_CONNECTED,
	APP_STATE_WIFI_CONNECTING,
	APP_STATE_WIFI_CONNECTED,
	APP_STATE_FAILED,
} app_state_t;

static volatile app_state_t s_app_state = APP_STATE_BOOT;

static char s_ssid[BLE_PROV_SSID_MAX_LEN + 1];
static char s_psk [BLE_PROV_PSK_MAX_LEN  + 1];

static void get_ip_str(char *buf, size_t len)
{
	struct net_if *iface = net_if_get_wifi_sta();
	if (!iface) {
		strncpy(buf, "N/A", len);
	return;
	}

	struct net_if_ipv4 *ipv4 = iface->config.ip.ipv4;
	if (!ipv4 || ipv4->unicast[0].ipv4.addr_type == NET_ADDR_ANY) {
		strncpy(buf, "Obtaining...", len);
	return;
	}

	net_addr_ntop(AF_INET, &ipv4->unicast[0].ipv4.address.in_addr, buf, len);
}

static void on_ble_connected(void)
{
	app_evt_t evt = { .type = APP_EVT_BLE_CONNECTED };
	k_msgq_put(&s_app_evq, &evt, K_NO_WAIT);
}

static void on_ble_disconnected(void)
{
	app_evt_t evt = { .type = APP_EVT_BLE_DISCONNECTED };
	k_msgq_put(&s_app_evq, &evt, K_NO_WAIT);
}

static void on_credentials_received(const char *ssid, const char *psk)
{
	app_evt_t evt = { .type = APP_EVT_CREDS_RECEIVED };
	strncpy(evt.ssid, ssid, sizeof(evt.ssid) - 1);
	strncpy(evt.psk,  psk,  sizeof(evt.psk)  - 1);
	k_msgq_put(&s_app_evq, &evt, K_NO_WAIT);
}

static const struct ble_prov_cb s_ble_cb = {
	.connected           = on_ble_connected,
	.disconnected        = on_ble_disconnected,
	.credentials_received = on_credentials_received,
};

static void on_wifi_state_changed(wifi_state_t state)
{
	app_evt_t evt = {0};

	switch (state) {
		case APP_WIFI_STATE_CONNECTING:
			evt.type = APP_EVT_WIFI_CONNECTING;
		break;
		case APP_WIFI_STATE_CONNECTED:
			evt.type = APP_EVT_WIFI_CONNECTED;
		break;
		case APP_WIFI_STATE_FAILED:
			evt.type = APP_EVT_WIFI_FAILED;
		break;
		case APP_WIFI_STATE_DISCONNECTED:
			evt.type = APP_EVT_WIFI_DISCONNECTED;
		break;
		default:
		return;
	}

	k_msgq_put(&s_app_evq, &evt, K_NO_WAIT);
}

static const struct wifi_mgr_cb s_wifi_cb = {
	.state_changed = on_wifi_state_changed,
};

static void app_handle_event(const app_evt_t *evt)
{
	switch (evt->type) {

	case APP_EVT_BLE_CONNECTED:
		if (s_app_state == APP_STATE_ADVERTISING) {
			s_app_state = APP_STATE_BLE_CONNECTED;
			ble_prov_set_status(PROV_STATUS_IDLE);
			ui_set_screen(UI_SCREEN_BLE_CONNECTED);
			LOG_INF("[APP] BLE connected! Waiting for credentials");
		}
	break;

	case APP_EVT_BLE_DISCONNECTED:
		if (s_app_state == APP_STATE_BLE_CONNECTED) {
			/* Central disconnected before sending credentials — re-advertise */
			s_app_state = APP_STATE_ADVERTISING;
			ui_set_screen(UI_SCREEN_ADVERTISING);
			ble_prov_start_adv();
			LOG_INF("[APP] BLE disconnected! Re-advertising");
		}
		/* If already connecting/connected, ignore BLE disconnect */
	break;

	case APP_EVT_CREDS_RECEIVED:
		if (s_app_state == APP_STATE_BLE_CONNECTED) {
			strncpy(s_ssid, evt->ssid, sizeof(s_ssid) - 1);
			strncpy(s_psk,  evt->psk,  sizeof(s_psk)  - 1);

			LOG_INF("[APP] Credentials received - SSID: \"%s\"", s_ssid);

			ble_prov_set_status(PROV_STATUS_CREDS_RCVD);
			ui_set_ssid(s_ssid);
			ui_set_screen(UI_SCREEN_CONNECTING);
			ble_prov_set_status(PROV_STATUS_CONNECTING);

			s_app_state = APP_STATE_WIFI_CONNECTING;

			int ret = wifi_mgr_connect(s_ssid, s_psk);
			if (ret) {
				LOG_ERR("[APP] wifi_mgr_connect failed immediately (err %d)", ret);
				ble_prov_set_status(PROV_STATUS_FAILED);
				ui_set_screen(UI_SCREEN_FAILED);
				s_app_state = APP_STATE_FAILED;
			}
		}
	break;

	case APP_EVT_WIFI_CONNECTING:
		/* Already shown connecting screen — nothing extra needed */
		LOG_DBG("[APP] Wi-Fi connecting...");
	break;

	case APP_EVT_WIFI_CONNECTED:
		char ip[NET_IPV4_ADDR_LEN];
		get_ip_str(ip, sizeof(ip));

		LOG_INF("[APP] Wi-Fi connected! IP: %s", ip);

		ble_prov_set_status(PROV_STATUS_CONNECTED);
		ui_set_ip(ip);
		ui_set_screen(UI_SCREEN_CONNECTED);
		s_app_state = APP_STATE_WIFI_CONNECTED;

		/* Provisioning done — stop BLE advertising / disconnect */
		bt_le_adv_stop();
	break;

	case APP_EVT_WIFI_FAILED:
		LOG_WRN("[APP] Wi-Fi connection failed");
		ble_prov_set_status(PROV_STATUS_FAILED);
		ui_set_screen(UI_SCREEN_FAILED);
		s_app_state = APP_STATE_FAILED;

		/* Re-start BLE advertising so user can retry from the mobile app */
		k_sleep(K_MSEC(500));
		s_app_state = APP_STATE_ADVERTISING;
		ble_prov_start_adv();
	break;

	case APP_EVT_WIFI_DISCONNECTED:
		if (s_app_state == APP_STATE_WIFI_CONNECTED) {
			LOG_WRN("[APP] Wi-Fi link lost - re-advertising");
			ble_prov_set_status(PROV_STATUS_DISCONNECTED);
			ui_set_screen(UI_SCREEN_ADVERTISING);
			s_app_state = APP_STATE_ADVERTISING;
			ble_prov_start_adv();
		}
	break;

	default:
	break;
	}
}

int main(void)
{
	int ret;

	LOG_INF("=== Wi-Fi + BLE Provisioning FRDM-RW612 ===");
	LOG_INF("Zephyr %s | LVGL v%d.%d",
	KERNEL_VERSION_STRING,
	CONFIG_LVGL_VERSION_MAJOR, CONFIG_LVGL_VERSION_MINOR);

	ret = ui_init();
	if (ret) {
		LOG_ERR("ui_init failed (%d)", ret);
		return ret;
	}

	k_sleep(K_MSEC(2000));

	ret = wifi_mgr_init(&s_wifi_cb);
	if (ret) {
		LOG_ERR("wifi_mgr_init failed (%d)", ret);
		return ret;
	}

	ret = ble_prov_init(&s_ble_cb);
	if (ret) {
		LOG_ERR("ble_prov_init failed (%d)", ret);
		return ret;
	}

	s_app_state = APP_STATE_ADVERTISING;
	ui_set_screen(UI_SCREEN_ADVERTISING);

	LOG_INF("Provisioning ready - advertising as \"%s\"",
	CONFIG_BT_DEVICE_NAME);

	while (1) {
		ui_tick();

		app_evt_t evt;
		while (k_msgq_get(&s_app_evq, &evt, K_NO_WAIT) == 0) {
			app_handle_event(&evt);
		}

		k_sleep(K_MSEC(10));
	}

	return 0;
}
```

## src/ble_prov.c
```c
/*
* Copyright 2026 NXP
*
* SPDX-License-Identifier: Apache-2.0
*/

#include <zephyr/kernel.h>
#include <zephyr/logging/log.h>
#include <zephyr/bluetooth/bluetooth.h>
#include <zephyr/bluetooth/conn.h>
#include <zephyr/bluetooth/gatt.h>
#include <zephyr/bluetooth/uuid.h>
#include <zephyr/settings/settings.h>

#include <string.h>

#include "ble_prov.h"

LOG_MODULE_REGISTER(ble_prov, LOG_LEVEL_INF);

#define PROV_UUID_ENC(short16) \
	BT_UUID_128_ENCODE(0x8b840000u | (uint32_t)(short16), \
						0xf6fa, 0x4e33, 0x9a0c, 0xe14d9f35f201)

static const struct bt_uuid_128 prov_svc_uuid  =
	BT_UUID_INIT_128(PROV_UUID_ENC(0x0001));
static const struct bt_uuid_128 prov_ssid_uuid =
	BT_UUID_INIT_128(PROV_UUID_ENC(0x0002));
static const struct bt_uuid_128 prov_psk_uuid  =
	BT_UUID_INIT_128(PROV_UUID_ENC(0x0003));
static const struct bt_uuid_128 prov_ctrl_uuid =
	BT_UUID_INIT_128(PROV_UUID_ENC(0x0004));
static const struct bt_uuid_128 prov_stat_uuid =
	BT_UUID_INIT_128(PROV_UUID_ENC(0x0005));

static char s_ssid[BLE_PROV_SSID_MAX_LEN + 1];
static char s_psk [BLE_PROV_PSK_MAX_LEN  + 1];
static uint8_t s_status = PROV_STATUS_IDLE;

static const struct ble_prov_cb *s_app_cb;
static struct bt_conn *s_conn;

static const struct bt_data adv_data[] = {
	BT_DATA_BYTES(BT_DATA_FLAGS, (BT_LE_AD_GENERAL | BT_LE_AD_NO_BREDR)),

	BT_DATA_BYTES(BT_DATA_UUID128_ALL,
					PROV_UUID_ENC(0x0001)),
};

static const struct bt_data sd_data[] = {
	BT_DATA(BT_DATA_NAME_COMPLETE,
			CONFIG_BT_DEVICE_NAME,
			sizeof(CONFIG_BT_DEVICE_NAME) - 1),
};

static ssize_t write_ssid(struct bt_conn *conn,
							const struct bt_gatt_attr *attr,
							const void *buf, uint16_t len,
							uint16_t offset, uint8_t flags)
{
	ARG_UNUSED(conn);
	ARG_UNUSED(attr);
	ARG_UNUSED(flags);

	if (offset != 0) {
		return BT_GATT_ERR(BT_ATT_ERR_INVALID_OFFSET);
	}
	if (len == 0 || len > BLE_PROV_SSID_MAX_LEN) {
		return BT_GATT_ERR(BT_ATT_ERR_INVALID_ATTRIBUTE_LEN);
	}

	memcpy(s_ssid, buf, len);
	s_ssid[len] = '\0';
	LOG_INF("SSID received: \"%s\"", s_ssid);
	return (ssize_t)len;
}

static ssize_t write_psk(struct bt_conn *conn,
							const struct bt_gatt_attr *attr,
							const void *buf, uint16_t len,
							uint16_t offset, uint8_t flags)
{
	ARG_UNUSED(conn);
	ARG_UNUSED(attr);
	ARG_UNUSED(flags);

	if (offset != 0) {
		return BT_GATT_ERR(BT_ATT_ERR_INVALID_OFFSET);
	}
	if (len > BLE_PROV_PSK_MAX_LEN) {
		return BT_GATT_ERR(BT_ATT_ERR_INVALID_ATTRIBUTE_LEN);
	}

	memcpy(s_psk, buf, len);
	s_psk[len] = '\0';
	LOG_INF("PSK received (%u bytes)", len);
	return (ssize_t)len;
}

static ssize_t write_ctrl(struct bt_conn *conn,
							const struct bt_gatt_attr *attr,
							const void *buf, uint16_t len,
							uint16_t offset, uint8_t flags)
{
	ARG_UNUSED(conn);
	ARG_UNUSED(attr);
	ARG_UNUSED(flags);

	if (offset != 0 || len != 1) {
		return BT_GATT_ERR(BT_ATT_ERR_INVALID_ATTRIBUTE_LEN);
	}

	uint8_t cmd = ((const uint8_t *)buf)[0];
	LOG_INF("CTRL byte: 0x%02x", cmd);

	if (cmd == 0x01) {
		if (s_ssid[0] == '\0') {
			LOG_WRN("Connect requested but SSID is empty");
			return BT_GATT_ERR(BT_ATT_ERR_VALUE_NOT_ALLOWED);
		}
		if (s_app_cb && s_app_cb->credentials_received) {
			s_app_cb->credentials_received(s_ssid, s_psk);
		}
	}

	return (ssize_t)len;
}

static ssize_t read_status(struct bt_conn *conn,
							const struct bt_gatt_attr *attr,
							void *buf, uint16_t len, uint16_t offset)
{
	return bt_gatt_attr_read(conn, attr, buf, len, offset,
								&s_status, sizeof(s_status));
}

static void status_ccc_changed(const struct bt_gatt_attr *attr, uint16_t value)
{
	LOG_DBG("Status CCC changed: %s",
				(value == BT_GATT_CCC_NOTIFY) ? "notify ON" : "notify OFF");
}

BT_GATT_SERVICE_DEFINE(prov_svc, BT_GATT_PRIMARY_SERVICE(&prov_svc_uuid),

    /* SSID — write only */
	BT_GATT_CHARACTERISTIC(&prov_ssid_uuid.uuid, BT_GATT_CHRC_WRITE, BT_GATT_PERM_WRITE, NULL, write_ssid, NULL),

    /* PSK — write only */
	BT_GATT_CHARACTERISTIC(&prov_psk_uuid.uuid, BT_GATT_CHRC_WRITE, BT_GATT_PERM_WRITE, NULL, write_psk, NULL),

    /* CONTROL — write only */
	BT_GATT_CHARACTERISTIC(&prov_ctrl_uuid.uuid, BT_GATT_CHRC_WRITE, BT_GATT_PERM_WRITE, NULL, write_ctrl, NULL),

    /* STATUS — read + notify */
	BT_GATT_CHARACTERISTIC(&prov_stat_uuid.uuid, BT_GATT_CHRC_READ | BT_GATT_CHRC_NOTIFY, BT_GATT_PERM_READ, read_status, NULL, &s_status),

	BT_GATT_CCC(status_ccc_changed, BT_GATT_PERM_READ | BT_GATT_PERM_WRITE),
);

static void on_connected(struct bt_conn *conn, uint8_t err)
{
	if (err) {
		LOG_ERR("BLE connect failed (err %u)", err);
		return;
	}

	s_conn = bt_conn_ref(conn);
	LOG_INF("BLE central connected");

	memset(s_ssid, 0, sizeof(s_ssid));
	memset(s_psk,  0, sizeof(s_psk));

	if (s_app_cb && s_app_cb->connected) {
		s_app_cb->connected();
	}
}

static void on_disconnected(struct bt_conn *conn, uint8_t reason)
{
	ARG_UNUSED(conn);
	LOG_INF("BLE central disconnected (reason 0x%02x)", reason);

	if (s_conn) {
		bt_conn_unref(s_conn);
		s_conn = NULL;
	}

	if (s_app_cb && s_app_cb->disconnected) {
		s_app_cb->disconnected();
	}
}

BT_CONN_CB_DEFINE(conn_callbacks) = {
	.connected    = on_connected,
	.disconnected = on_disconnected,
};

void ble_prov_start_adv(void)
{
	int err = bt_le_adv_start(BT_LE_ADV_CONN_FAST_1,
								adv_data, ARRAY_SIZE(adv_data),
								sd_data,  ARRAY_SIZE(sd_data));
	if (err && err != -EALREADY) {
		LOG_ERR("Advertising start failed (err %d)", err);
	} else {
		LOG_INF("BLE advertising started - device name: %s",
		CONFIG_BT_DEVICE_NAME);
	}
}

void ble_prov_set_status(prov_status_t status)
{
	s_status = (uint8_t)status;

	int err = bt_gatt_notify_uuid(NULL, &prov_stat_uuid.uuid, prov_svc.attrs, &s_status, sizeof(s_status));
	if (err && err != -ENOTCONN) {
		LOG_WRN("Status notify failed (err %d)", err);
	}
}

int ble_prov_init(const struct ble_prov_cb *cb)
{
	if (!cb) {
		return -EINVAL;
	}
	s_app_cb = cb;

	int err = settings_load();
	if (err) {
		LOG_WRN("settings_load failed (err %d) - continuing", err);
	}

	err = bt_enable(NULL);
	if (err) {
		LOG_ERR("bt_enable failed (err %d)", err);
		return err;
	}
	LOG_INF("Bluetooth enabled");

	ble_prov_start_adv();
	return 0;
}
```

## src/ble_prov.h
```c
/*
* Copyright 2026 NXP
*
* SPDX-License-Identifier: Apache-2.0
*/

#ifndef BLE_PROV_H
#define BLE_PROV_H

#include <stdint.h>
#include <stddef.h>
#include <stdbool.h>

#ifdef __cplusplus
extern "C" {
#endif

#define BLE_PROV_SSID_MAX_LEN  32
#define BLE_PROV_PSK_MAX_LEN   64

typedef enum {
	PROV_STATUS_IDLE          = 0x00, /**< Waiting for credentials          */
	PROV_STATUS_CREDS_RCVD    = 0x01, /**< SSID + PSK received              */
	PROV_STATUS_CONNECTING    = 0x02, /**< Wi-Fi connect in progress        */
	PROV_STATUS_CONNECTED     = 0x03, /**< Wi-Fi connected successfully     */
	PROV_STATUS_FAILED        = 0x04, /**< Wi-Fi connect failed             */
	PROV_STATUS_DISCONNECTED  = 0x05, /**< Wi-Fi link lost                  */
} prov_status_t;

struct ble_prov_cb {

	void (*credentials_received)(const char *ssid, const char *psk);

	void (*connected)(void);

	void (*disconnected)(void);
};

int ble_prov_init(const struct ble_prov_cb *cb);

void ble_prov_set_status(prov_status_t status);

void ble_prov_start_adv(void);

#ifdef __cplusplus
}
#endif

#endif /* BLE_PROV_H */
```

## src/ui.c
```c
/*
* Copyright 2026 NXP
*
* SPDX-License-Identifier: Apache-2.0
*/

#include <zephyr/kernel.h>
#include <zephyr/logging/log.h>
#include <zephyr/drivers/display.h>
#include <lvgl.h>

#include <string.h>
#include <stdio.h>

#include "ui.h"

LOG_MODULE_REGISTER(ui, LOG_LEVEL_INF);

#define DISP_W  480
#define DISP_H  320

#define COL_NXP_ORANGE   lv_color_hex(0xFF6600)
#define COL_NXP_DARK     lv_color_hex(0x1A1A2E)
#define COL_NXP_BLUE     lv_color_hex(0x0066CC)
#define COL_WHITE        lv_color_hex(0xFFFFFF)
#define COL_GREEN        lv_color_hex(0x00C853)
#define COL_RED          lv_color_hex(0xFF1744)
#define COL_GREY         lv_color_hex(0x607D8B)
#define COL_LIGHT_GREY   lv_color_hex(0xECEFF1)

typedef enum {
	UI_MSG_SET_SCREEN,
	UI_MSG_SET_SSID,
	UI_MSG_SET_IP,
} ui_msg_type_t;

typedef struct {
	ui_msg_type_t type;
	union {
		ui_screen_t screen;
		char        str[64];
	};
} ui_msg_t;

K_MSGQ_DEFINE(s_ui_msgq, sizeof(ui_msg_t), 8, 4);


static char s_ssid[33];
static char s_ip[20];

static lv_obj_t *s_screens[6]; /* one per ui_screen_t */
static ui_screen_t s_current = UI_SCREEN_BOOT;


static void build_screen_boot(void);
static void build_screen_advertising(void);
static void build_screen_ble_connected(void);
static void build_screen_connecting(void);
static void build_screen_connected(void);
static void build_screen_failed(void);

static void apply_dark_bg(lv_obj_t *scr)
{
	lv_obj_set_style_bg_color(scr, COL_NXP_DARK, LV_PART_MAIN);
	lv_obj_set_style_bg_opa(scr, LV_OPA_COVER, LV_PART_MAIN);
}

static lv_obj_t *make_title(lv_obj_t *parent, const char *text, int32_t y_ofs)
{
	lv_obj_t *lbl = lv_label_create(parent);
	lv_label_set_text(lbl, text);
	lv_obj_set_style_text_font(lbl, &lv_font_montserrat_24, LV_PART_MAIN);
	lv_obj_set_style_text_color(lbl, COL_NXP_ORANGE, LV_PART_MAIN);
	lv_obj_align(lbl, LV_ALIGN_TOP_MID, 0, y_ofs);
	return lbl;
}

static lv_obj_t *make_subtitle(lv_obj_t *parent, const char *text, int32_t y_ofs)
{
	lv_obj_t *lbl = lv_label_create(parent);
	lv_label_set_text(lbl, text);
	lv_obj_set_style_text_font(lbl, &lv_font_montserrat_16, LV_PART_MAIN);
	lv_obj_set_style_text_color(lbl, COL_WHITE, LV_PART_MAIN);
	lv_obj_set_style_text_align(lbl, LV_TEXT_ALIGN_CENTER, LV_PART_MAIN);
	lv_label_set_long_mode(lbl, LV_LABEL_LONG_WRAP);
	lv_obj_set_width(lbl, DISP_W - 40);
	lv_obj_align(lbl, LV_ALIGN_TOP_MID, 0, y_ofs);
	return lbl;
}

static lv_obj_t *make_spinner(lv_obj_t *parent, int32_t y_ofs)
{
	lv_obj_t *sp = lv_spinner_create(parent);
	lv_obj_set_size(sp, 80, 80);
	lv_obj_align(sp, LV_ALIGN_TOP_MID, 0, y_ofs);
	lv_obj_set_style_arc_color(sp, COL_NXP_ORANGE, LV_PART_INDICATOR);
	lv_obj_set_style_arc_color(sp, COL_GREY, LV_PART_MAIN);
	lv_obj_set_style_arc_width(sp, 8, LV_PART_INDICATOR);
	lv_obj_set_style_arc_width(sp, 8, LV_PART_MAIN);
	return sp;
}

static lv_obj_t *make_led(lv_obj_t *parent, lv_color_t color, int32_t y_ofs)
{
	lv_obj_t *led = lv_led_create(parent);
	lv_obj_set_size(led, 20, 20);
	lv_led_set_color(led, color);
	lv_led_on(led);
	lv_obj_align(led, LV_ALIGN_TOP_MID, 0, y_ofs);
	return led;
}

static void make_divider(lv_obj_t *parent, int32_t y_ofs)
{
	static lv_point_precise_t pts[2] = {{20, 0}, {DISP_W - 20, 0}};
	lv_obj_t *line = lv_line_create(parent);
	lv_line_set_points(line, pts, 2);
	lv_obj_set_style_line_color(line, COL_NXP_ORANGE, LV_PART_MAIN);
	lv_obj_set_style_line_width(line, 2, LV_PART_MAIN);
	lv_obj_set_style_line_opa(line, LV_OPA_50, LV_PART_MAIN);
	lv_obj_align(line, LV_ALIGN_TOP_MID, 0, y_ofs);
}

static void make_step_bar(lv_obj_t *parent, int active_step)
{
	static const char *labels[] = {"BLE Adv", "BLE Conn", "Wi-Fi", "Done"};
	int32_t x_start = 40;
	int32_t step_w  = (DISP_W - 80) / 4;
	
	for (int i = 0; i < 4; i++) {
		lv_obj_t *dot = lv_obj_create(parent);
		lv_obj_set_size(dot, 12, 12);
		lv_obj_set_style_radius(dot, LV_RADIUS_CIRCLE, LV_PART_MAIN);
		lv_obj_set_style_bg_color(dot, (i <= active_step) ? COL_NXP_ORANGE : COL_GREY, LV_PART_MAIN);
		lv_obj_set_style_border_width(dot, 0, LV_PART_MAIN);
		lv_obj_set_pos(dot, x_start + i * step_w + step_w / 2 - 6, DISP_H - 30);
		lv_obj_t *lbl = lv_label_create(parent);
		lv_label_set_text(lbl, labels[i]);
		lv_obj_set_style_text_font(lbl, &lv_font_montserrat_14, LV_PART_MAIN);
		lv_obj_set_style_text_color(lbl, (i <= active_step) ? COL_NXP_ORANGE : COL_GREY, LV_PART_MAIN);
		lv_obj_set_pos(lbl, x_start + i * step_w, DISP_H - 16);

		if (i < 3) {
			static lv_point_precise_t seg[2];
			seg[0].x = x_start + i * step_w + step_w / 2 + 6;
			seg[0].y = DISP_H - 24;
			seg[1].x = x_start + (i + 1) * step_w + step_w / 2 - 6;
			seg[1].y = DISP_H - 24;
			lv_obj_t *ln = lv_line_create(parent);
			lv_line_set_points(ln, seg, 2);
			lv_obj_set_style_line_color(ln, (i < active_step) ? COL_NXP_ORANGE : COL_GREY, LV_PART_MAIN);
			lv_obj_set_style_line_width(ln, 2, LV_PART_MAIN);
		}
	}
}

static void build_screen_boot(void)
{
	lv_obj_t *scr = lv_obj_create(NULL);
	apply_dark_bg(scr);
	s_screens[UI_SCREEN_BOOT] = scr;

	lv_obj_t *logo = lv_label_create(scr);
	lv_label_set_text(logo, "NXP");
	lv_obj_set_style_text_font(logo, &lv_font_montserrat_32, LV_PART_MAIN);
	lv_obj_set_style_text_color(logo, COL_NXP_ORANGE, LV_PART_MAIN);
	lv_obj_align(logo, LV_ALIGN_CENTER, 0, -50);

	lv_obj_t *prod = lv_label_create(scr);
	lv_label_set_text(prod, "FRDM-RW612");
	lv_obj_set_style_text_font(prod, &lv_font_montserrat_24, LV_PART_MAIN);
	lv_obj_set_style_text_color(prod, COL_WHITE, LV_PART_MAIN);
	lv_obj_align(prod, LV_ALIGN_CENTER, 0, -10);

	lv_obj_t *app = lv_label_create(scr);
	lv_label_set_text(app, "Wi-Fi + BLE Provisioning");
	lv_obj_set_style_text_font(app, &lv_font_montserrat_16, LV_PART_MAIN);
	lv_obj_set_style_text_color(app, COL_GREY, LV_PART_MAIN);
	lv_obj_align(app, LV_ALIGN_CENTER, 0, 25);

	lv_obj_t *bar = lv_bar_create(scr);
	lv_obj_set_size(bar, 200, 8);
	lv_obj_align(bar, LV_ALIGN_CENTER, 0, 70);
	lv_obj_set_style_bg_color(bar, COL_GREY, LV_PART_MAIN);
	lv_obj_set_style_bg_color(bar, COL_NXP_ORANGE, LV_PART_INDICATOR);
	lv_obj_set_style_radius(bar, 4, LV_PART_MAIN);
	lv_obj_set_style_radius(bar, 4, LV_PART_INDICATOR);

	lv_anim_t a;
	lv_anim_init(&a);
	lv_anim_set_exec_cb(&a, (lv_anim_exec_xcb_t)lv_bar_set_value);
	lv_anim_set_var(&a, bar);
	lv_anim_set_values(&a, 0, 100);
	lv_anim_set_duration(&a, 1500);
	lv_anim_start(&a);

	lv_obj_t *ver = lv_label_create(scr);
	lv_label_set_text(ver, "Zephyr 4.4 | LVGL v9");
	lv_obj_set_style_text_font(ver, &lv_font_montserrat_14, LV_PART_MAIN);
	lv_obj_set_style_text_color(ver, COL_GREY, LV_PART_MAIN);
	lv_obj_align(ver, LV_ALIGN_BOTTOM_MID, 0, -8);
}

static void build_screen_advertising(void)
{
	lv_obj_t *scr = lv_obj_create(NULL);
	apply_dark_bg(scr);
	s_screens[UI_SCREEN_ADVERTISING] = scr;
	
	make_title(scr, "BLE Advertising", 12);
	make_divider(scr, 44);
	
	lv_obj_t *bt_icon = lv_label_create(scr);
	lv_label_set_text(bt_icon, LV_SYMBOL_BLUETOOTH);
	lv_obj_set_style_text_font(bt_icon, &lv_font_montserrat_32, LV_PART_MAIN);
	lv_obj_set_style_text_color(bt_icon, COL_NXP_BLUE, LV_PART_MAIN);
	lv_obj_align(bt_icon, LV_ALIGN_TOP_MID, -50, 60);
	
	make_spinner(scr, 55);
	lv_obj_t *msg = make_subtitle(scr, "Waiting for mobile app\nto connect over BLE...", 155);
	ARG_UNUSED(msg);
		
	lv_obj_t *box = lv_obj_create(scr);
	lv_obj_set_size(box, 280, 44);
	lv_obj_align(box, LV_ALIGN_TOP_MID, 0, 210);
	lv_obj_set_style_bg_color(box, lv_color_hex(0x0D1B2A), LV_PART_MAIN);
	lv_obj_set_style_border_color(box, COL_NXP_ORANGE, LV_PART_MAIN);
	lv_obj_set_style_border_width(box, 1, LV_PART_MAIN);
	lv_obj_set_style_radius(box, 6, LV_PART_MAIN);
	lv_obj_set_style_pad_all(box, 6, LV_PART_MAIN);

	lv_obj_t *dev_lbl = lv_label_create(box);
	lv_label_set_text_fmt(dev_lbl, LV_SYMBOL_BLUETOOTH "  %s", CONFIG_BT_DEVICE_NAME);
	lv_obj_set_style_text_font(dev_lbl, &lv_font_montserrat_14, LV_PART_MAIN);
	lv_obj_set_style_text_color(dev_lbl, COL_WHITE, LV_PART_MAIN);
	lv_obj_align(dev_lbl, LV_ALIGN_CENTER, 0, 0);
	
	make_step_bar(scr, 0);
}

static void build_screen_ble_connected(void)
{
	lv_obj_t *scr = lv_obj_create(NULL);
	apply_dark_bg(scr);
	s_screens[UI_SCREEN_BLE_CONNECTED] = scr;

	make_title(scr, "BLE Connected", 12);
	make_divider(scr, 44);

	make_led(scr, COL_NXP_BLUE, 60);

	lv_obj_t *msg = make_subtitle(scr, "Mobile app connected!\nSend Wi-Fi credentials\nvia the provisioning app.", 90);
	ARG_UNUSED(msg);

	lv_obj_t *dots = lv_label_create(scr);
	lv_label_set_text(dots, "Awaiting SSID + Password...");
	lv_obj_set_style_text_font(dots, &lv_font_montserrat_14, LV_PART_MAIN);
	lv_obj_set_style_text_color(dots, COL_NXP_ORANGE, LV_PART_MAIN);
	lv_obj_align(dots, LV_ALIGN_TOP_MID, 0, 200);

	lv_anim_t a;
	lv_anim_init(&a);
	lv_anim_set_exec_cb(&a, (lv_anim_exec_xcb_t)lv_obj_set_style_text_opa);
	lv_anim_set_var(&a, dots);
	lv_anim_set_values(&a, LV_OPA_TRANSP, LV_OPA_COVER);
	lv_anim_set_duration(&a, 800);
	lv_anim_set_playback_duration(&a, 800);
	lv_anim_set_repeat_count(&a, LV_ANIM_REPEAT_INFINITE);
	lv_anim_start(&a);

	make_step_bar(scr, 1);
}

static void build_screen_connecting(void)
{
	lv_obj_t *scr = lv_obj_create(NULL);
	apply_dark_bg(scr);
	s_screens[UI_SCREEN_CONNECTING] = scr;

	make_title(scr, "Connecting to Wi-Fi", 12);
	make_divider(scr, 44);

	make_spinner(scr, 60);

	lv_obj_t *ssid_lbl = lv_label_create(scr);
	lv_label_set_text_fmt(ssid_lbl, LV_SYMBOL_WIFI "  %s", s_ssid[0] ? s_ssid : "...");
	lv_obj_set_style_text_font(ssid_lbl, &lv_font_montserrat_16, LV_PART_MAIN);
	lv_obj_set_style_text_color(ssid_lbl, COL_WHITE, LV_PART_MAIN);
	lv_obj_align(ssid_lbl, LV_ALIGN_TOP_MID, 0, 155);

	lv_obj_t *hint = make_subtitle(scr,"Authenticating and\nobtaining IP address...", 185);
	ARG_UNUSED(hint);

	make_step_bar(scr, 2);
}

static void build_screen_connected(void)
{
	lv_obj_t *scr = lv_obj_create(NULL);
	apply_dark_bg(scr);
	s_screens[UI_SCREEN_CONNECTED] = scr;
	
	make_title(scr, "Wi-Fi Connected!", 12);
	make_divider(scr, 44);

	lv_obj_t *chk = lv_label_create(scr);
	lv_label_set_text(chk, LV_SYMBOL_OK);
	lv_obj_set_style_text_font(chk, &lv_font_montserrat_32, LV_PART_MAIN);
	lv_obj_set_style_text_color(chk, COL_GREEN, LV_PART_MAIN);
	lv_obj_align(chk, LV_ALIGN_TOP_MID, 0, 55);

	lv_obj_t *ssid_row = lv_obj_create(scr);
	lv_obj_set_size(ssid_row, 340, 36);
	lv_obj_align(ssid_row, LV_ALIGN_TOP_MID, 0, 110);
	lv_obj_set_style_bg_color(ssid_row, lv_color_hex(0x0D1B2A), LV_PART_MAIN);
	lv_obj_set_style_border_color(ssid_row, COL_GREEN, LV_PART_MAIN);
	lv_obj_set_style_border_width(ssid_row, 1, LV_PART_MAIN);
	lv_obj_set_style_radius(ssid_row, 6, LV_PART_MAIN);
	lv_obj_set_style_pad_all(ssid_row, 6, LV_PART_MAIN);

	lv_obj_t *ssid_val = lv_label_create(ssid_row);
	lv_label_set_text_fmt(ssid_val, LV_SYMBOL_WIFI "  %s", s_ssid[0] ? s_ssid : "N/A");
	lv_obj_set_style_text_font(ssid_val, &lv_font_montserrat_14, LV_PART_MAIN);
	lv_obj_set_style_text_color(ssid_val, COL_WHITE, LV_PART_MAIN);
	lv_obj_align(ssid_val, LV_ALIGN_CENTER, 0, 0);

	lv_obj_t *ip_row = lv_obj_create(scr);
	lv_obj_set_size(ip_row, 340, 36);
	lv_obj_align(ip_row, LV_ALIGN_TOP_MID, 0, 155);
	lv_obj_set_style_bg_color(ip_row, lv_color_hex(0x0D1B2A), LV_PART_MAIN);
	lv_obj_set_style_border_color(ip_row, COL_NXP_ORANGE, LV_PART_MAIN);
	lv_obj_set_style_border_width(ip_row, 1, LV_PART_MAIN);
	lv_obj_set_style_radius(ip_row, 6, LV_PART_MAIN);
	lv_obj_set_style_pad_all(ip_row, 6, LV_PART_MAIN);

	lv_obj_t *ip_val = lv_label_create(ip_row);
	lv_label_set_text_fmt(ip_val, LV_SYMBOL_HOME "  IP: %s", s_ip[0] ? s_ip : "Obtaining...");
	lv_obj_set_style_text_font(ip_val, &lv_font_montserrat_14, LV_PART_MAIN);
	lv_obj_set_style_text_color(ip_val, COL_NXP_ORANGE, LV_PART_MAIN);
	lv_obj_align(ip_val, LV_ALIGN_CENTER, 0, 0);

	lv_obj_t *done = make_subtitle(scr, "Provisioning complete!", 205);
	lv_obj_set_style_text_color(done, COL_GREEN, LV_PART_MAIN);

	make_step_bar(scr, 3);
}

static void retry_btn_cb(lv_event_t *e)
{
	ARG_UNUSED(e);
	LOG_INF("Retry button pressed");
	ui_set_screen(UI_SCREEN_ADVERTISING);
}

static void build_screen_failed(void)
{
	lv_obj_t *scr = lv_obj_create(NULL);
	apply_dark_bg(scr);
	s_screens[UI_SCREEN_FAILED] = scr;

	make_title(scr, "Connection Failed", 12);
	make_divider(scr, 44);

	lv_obj_t *cross = lv_label_create(scr);
	lv_label_set_text(cross, LV_SYMBOL_CLOSE);
	lv_obj_set_style_text_font(cross, &lv_font_montserrat_32, LV_PART_MAIN);
	lv_obj_set_style_text_color(cross, COL_RED, LV_PART_MAIN);
	lv_obj_align(cross, LV_ALIGN_TOP_MID, 0, 55);

	lv_obj_t *msg = make_subtitle(scr, "Could not connect to Wi-Fi.\nCheck SSID and password,\nthen try again.", 105);
	ARG_UNUSED(msg);

	lv_obj_t *btn = lv_button_create(scr);
	lv_obj_set_size(btn, 160, 44);
	lv_obj_align(btn, LV_ALIGN_TOP_MID, 0, 210);
	lv_obj_set_style_bg_color(btn, COL_NXP_ORANGE, LV_PART_MAIN);
	lv_obj_set_style_radius(btn, 8, LV_PART_MAIN);
	lv_obj_add_event_cb(btn, retry_btn_cb, LV_EVENT_CLICKED, NULL);

	lv_obj_t *btn_lbl = lv_label_create(btn);
	lv_label_set_text(btn_lbl, LV_SYMBOL_REFRESH "  Retry");
	lv_obj_set_style_text_font(btn_lbl, &lv_font_montserrat_16, LV_PART_MAIN);
	lv_obj_set_style_text_color(btn_lbl, COL_WHITE, LV_PART_MAIN);
	lv_obj_align(btn_lbl, LV_ALIGN_CENTER, 0, 0);

	make_step_bar(scr, 1);
}

static void do_set_screen(ui_screen_t screen)
{
	if (screen >= ARRAY_SIZE(s_screens)) {
		return;
	}

	if (s_screens[screen]) {
		lv_obj_delete(s_screens[screen]);
		s_screens[screen] = NULL;
	}

	switch (screen) {
		case UI_SCREEN_BOOT:          build_screen_boot();          break;
		case UI_SCREEN_ADVERTISING:   build_screen_advertising();   break;
		case UI_SCREEN_BLE_CONNECTED: build_screen_ble_connected(); break;
		case UI_SCREEN_CONNECTING:    build_screen_connecting();    break;
		case UI_SCREEN_CONNECTED:     build_screen_connected();     break;
		case UI_SCREEN_FAILED:        build_screen_failed();        break;
		default: return;
	}

	lv_screen_load_anim(s_screens[screen], LV_SCR_LOAD_ANIM_FADE_IN, 300, 0, false);
	s_current = screen;
	LOG_DBG("UI screen: %d", screen);
}

int ui_init(void)
{
	const struct device *disp = DEVICE_DT_GET(DT_CHOSEN(zephyr_display));

	if (!device_is_ready(disp)) {
		LOG_ERR("Display device not ready");
		return -ENODEV;
	}

	memset(s_screens, 0, sizeof(s_screens));
	memset(s_ssid, 0, sizeof(s_ssid));
	memset(s_ip,   0, sizeof(s_ip));

	build_screen_boot();
	lv_screen_load(s_screens[UI_SCREEN_BOOT]);
	s_current = UI_SCREEN_BOOT;

	lv_timer_handler();
	display_blanking_off(disp);

	LOG_INF("UI initialised - display %dx%d", DISP_W, DISP_H);
	return 0;
}

void ui_set_screen(ui_screen_t screen)
{
	ui_msg_t msg = {
		.type   = UI_MSG_SET_SCREEN,
		.screen = screen,
	};
	k_msgq_put(&s_ui_msgq, &msg, K_NO_WAIT);
}

void ui_set_ssid(const char *ssid)
{
	ui_msg_t msg = { .type = UI_MSG_SET_SSID };
	strncpy(msg.str, ssid, sizeof(msg.str) - 1);
	k_msgq_put(&s_ui_msgq, &msg, K_NO_WAIT);
}

void ui_set_ip(const char *ip_str)
{
	ui_msg_t msg = { .type = UI_MSG_SET_IP };
	strncpy(msg.str, ip_str, sizeof(msg.str) - 1);
	k_msgq_put(&s_ui_msgq, &msg, K_NO_WAIT);
}

void ui_tick(void)
{
	ui_msg_t msg;
	while (k_msgq_get(&s_ui_msgq, &msg, K_NO_WAIT) == 0) {
		switch (msg.type) {
		case UI_MSG_SET_SCREEN:
			do_set_screen(msg.screen);
			break;
		case UI_MSG_SET_SSID:
			strncpy(s_ssid, msg.str, sizeof(s_ssid) - 1);
			break;
		case UI_MSG_SET_IP:
			strncpy(s_ip, msg.str, sizeof(s_ip) - 1);
			if (s_current == UI_SCREEN_CONNECTED) {
				do_set_screen(UI_SCREEN_CONNECTED);
			}
			break;
		}
	}

	lv_timer_handler();
}
```

## src/ui.h
```c
/*
* Copyright 2026 NXP
*
* SPDX-License-Identifier: Apache-2.0
*/

#ifndef UI_H
#define UI_H

#include <stdint.h>
#include <stdbool.h>

#ifdef __cplusplus
extern "C" {
#endif

typedef enum {
	UI_SCREEN_BOOT = 0,      /**< Splash / boot animation                  */
	UI_SCREEN_ADVERTISING,   /**< "Waiting for BLE connection" spinner      */
	UI_SCREEN_BLE_CONNECTED, /**< "BLE connected — awaiting credentials"   */
	UI_SCREEN_CONNECTING,    /**< Wi-Fi connecting spinner + SSID display   */
	UI_SCREEN_CONNECTED,     /**< Success: IP address + signal strength     */
	UI_SCREEN_FAILED,        /**< Error screen with retry prompt            */
} ui_screen_t;

int ui_init(void);

void ui_set_screen(ui_screen_t screen);

void ui_set_ssid(const char *ssid);

void ui_set_ip(const char *ip_str);

void ui_tick(void);

#ifdef __cplusplus
}
#endif

#endif /* UI_H */
```

## src/wifi_mgr.c
```c
/*
* Copyright 2026 NXP
*
* SPDX-License-Identifier: Apache-2.0
*/

#include <zephyr/kernel.h>
#include <zephyr/logging/log.h>
#include <zephyr/net/net_if.h>
#include <zephyr/net/net_mgmt.h>
#include <zephyr/net/net_event.h>
#include <zephyr/net/wifi.h>
#include <zephyr/net/wifi_mgmt.h>

#include <string.h>

#include "wifi_mgr.h"

LOG_MODULE_REGISTER(wifi_mgr, LOG_LEVEL_INF);

#define WIFI_MGMT_EVENTS \
	(NET_EVENT_WIFI_CONNECT_RESULT    | \
	NET_EVENT_WIFI_DISCONNECT_RESULT | \
	NET_EVENT_WIFI_DISCONNECT_COMPLETE)

#define IPV4_MGMT_EVENTS \
	(NET_EVENT_IPV4_DHCP_BOUND)

static struct net_mgmt_event_callback s_wifi_cb;
static struct net_mgmt_event_callback s_ipv4_cb;

static volatile wifi_state_t s_state = APP_WIFI_STATE_IDLE;
static const struct wifi_mgr_cb *s_app_cb;

static void set_state(wifi_state_t new_state)
{
	s_state = new_state;
	if (s_app_cb && s_app_cb->state_changed) {
		s_app_cb->state_changed(new_state);
	}
}

static void wifi_event_handler(struct net_mgmt_event_callback *cb,
                                uint64_t mgmt_event,
                                struct net_if *iface)
{
	ARG_UNUSED(iface);

	switch (mgmt_event) {
		case NET_EVENT_WIFI_CONNECT_RESULT: {
			const struct wifi_status *st =
			(const struct wifi_status *)cb->info;
			if (st->status == 0) {
				LOG_INF("Wi-Fi connected - waiting for DHCP");
				set_state(APP_WIFI_STATE_CONNECTING); /* DHCP still pending */
			} else {
				LOG_ERR("Wi-Fi connect failed (status %d)", st->status);
				set_state(APP_WIFI_STATE_FAILED);
			}
			break;
		}
		case NET_EVENT_WIFI_DISCONNECT_RESULT:
		case NET_EVENT_WIFI_DISCONNECT_COMPLETE:
			LOG_INF("Wi-Fi disconnected");
			set_state(APP_WIFI_STATE_DISCONNECTED);
			break;
		default:
		break;
	}
}

static void ipv4_event_handler(struct net_mgmt_event_callback *cb,
                                uint64_t mgmt_event,
                                struct net_if *iface)
{
	ARG_UNUSED(cb);
	ARG_UNUSED(iface);

	if (mgmt_event == NET_EVENT_IPV4_DHCP_BOUND) {
		LOG_INF("DHCP bound - Wi-Fi fully connected");
		set_state(APP_WIFI_STATE_CONNECTED);
	}
}

int wifi_mgr_init(const struct wifi_mgr_cb *cb)
{
	if (!cb) {
		return -EINVAL;
	}
	s_app_cb = cb;

	net_mgmt_init_event_callback(&s_wifi_cb, wifi_event_handler, WIFI_MGMT_EVENTS);
	net_mgmt_add_event_callback(&s_wifi_cb);

	net_mgmt_init_event_callback(&s_ipv4_cb, ipv4_event_handler, IPV4_MGMT_EVENTS);
	net_mgmt_add_event_callback(&s_ipv4_cb);

	LOG_INF("Wi-Fi manager initialised");
	return 0;
}

int wifi_mgr_connect(const char *ssid, const char *psk)
{
	if (!ssid || ssid[0] == '\0') {
		return -EINVAL;
	}

	struct net_if *iface = NULL;
	for (int i = 0; i < 20; i++) {
		iface = net_if_get_wifi_sta();
		if (iface) {
			break;
		}
		LOG_DBG("Waiting for Wi-Fi STA interface... (%d/20)", i + 1);
		k_sleep(K_MSEC(500));
	}
	if (!iface) {
		LOG_ERR("No Wi-Fi STA interface found after 10s");
		return -ENODEV;
	}

	struct wifi_connect_req_params params = {
		.ssid        = (const uint8_t *)ssid,
		.ssid_length = (uint8_t)strlen(ssid),
		.psk         = (psk && psk[0] != '\0') ? (const uint8_t *)psk : NULL,
		.psk_length  = (psk && psk[0] != '\0') ? (uint8_t)strlen(psk) : 0,
		.security    = (psk && psk[0] != '\0')
		? WIFI_SECURITY_TYPE_PSK
		: WIFI_SECURITY_TYPE_NONE,
		.channel     = WIFI_CHANNEL_ANY,
		.band        = WIFI_FREQ_BAND_UNKNOWN,
		.mfp         = WIFI_MFP_OPTIONAL,
		.timeout     = SYS_FOREVER_MS,
	};

	LOG_INF("Connecting to SSID: \"%s\" (security: %s)", ssid, (params.security == WIFI_SECURITY_TYPE_PSK) ? "WPA2-PSK" : "Open");

	set_state(APP_WIFI_STATE_CONNECTING);

	int ret = net_mgmt(NET_REQUEST_WIFI_CONNECT, iface,	&params, sizeof(params));
	if (ret) {
		LOG_ERR("net_mgmt CONNECT request failed (err %d)", ret);
		set_state(APP_WIFI_STATE_FAILED);
	}
	return ret;
}

int wifi_mgr_disconnect(void)
{
	struct net_if *iface = net_if_get_wifi_sta();
	if (!iface) {
		return -ENODEV;
	}
	return net_mgmt(NET_REQUEST_WIFI_DISCONNECT, iface, NULL, 0);
}

wifi_state_t wifi_mgr_state(void)
{
	return s_state;
}
```

## src/wifi_mgr.h
```c
/*
* Copyright 2026 NXP
*
* SPDX-License-Identifier: Apache-2.0
*/

#ifndef WIFI_MGR_H
#define WIFI_MGR_H

#include <stdint.h>
#include <stdbool.h>

#ifdef __cplusplus
extern "C" {
#endif

#define WIFI_MGR_SSID_MAX_LEN  33   /* 32 chars + NUL */
#define WIFI_MGR_PSK_MAX_LEN   65   /* 64 chars + NUL */

typedef enum {
	APP_WIFI_STATE_IDLE        = 0,
	APP_WIFI_STATE_CONNECTING,
	APP_WIFI_STATE_CONNECTED,
	APP_WIFI_STATE_DISCONNECTED,
	APP_WIFI_STATE_FAILED,
} wifi_state_t;

struct wifi_mgr_cb {
	void (*state_changed)(wifi_state_t state);
};

int wifi_mgr_init(const struct wifi_mgr_cb *cb);

int wifi_mgr_connect(const char *ssid, const char *psk);

int wifi_mgr_disconnect(void);

wifi_state_t wifi_mgr_state(void);

#ifdef __cplusplus
}
#endif

#endif /* WIFI_MGR_H */
```
